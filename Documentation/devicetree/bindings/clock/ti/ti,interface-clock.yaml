## Documentation/devicetree/bindings/clock/ti/ti,interface-clock.yaml
```yaml
# SPDX-License-Identifier: (GPL-2.0-only OR BSD-2-Clause)
%YAML 1.2
---
$id: http://devicetree.org/schemas/clock/ti/ti,interface-clock.yaml#
$schema: http://devicetree.org/meta-schemas/core.yaml#

title: Texas Instruments interface clock.

maintainers:
  - Tero Kristo <kristo@kernel.org>

description: |
  This binding uses the common clock binding[1]. This clock is
  quite much similar to the basic gate-clock[2], however,
  it supports a number of additional features, including
  companion clock finding (match corresponding functional gate
  clock) and hardware autoidle enable / disable.

  [1] Documentation/devicetree/bindings/clock/clock-bindings.txt
  [2] Documentation/devicetree/bindings/clock/gpio-gate-clock.yaml


properties:
  compatible:
    enum:
      - ti,omap3-interface-clock           # basic OMAP3 interface clock
      - ti,omap3-no-wait-interface-clock   # interface clock which has no hardware
                                           # capability for waiting clock to be ready
      - ti,omap3-hsotgusb-interface-clock  # interface clock with USB specific HW handling
      - ti,omap3-dss-interface-clock       # interface clock with DSS specific HW handling
      - ti,omap3-ssi-interface-clock       # interface clock with SSI specific HW handling
      - ti,am35xx-interface-clock          # interface clock with AM35xx specific HW handling
      - ti,omap2430-interface-clock        # interface clock with OMAP2430 specific HW handling
  "#clock-cells":
    const: 0

  clocks:
    maxItems: 1

  clock-output-names:
    maxItems: 1

  reg:
    description:
      if not specified, value from parent is used
    maxItems: 1

  ti,bit-shift:
    description:
      bit shift for the bit enabling/disabling the clock
    $ref: /schemas/types.yaml#/definitions/uint32
    default: 0

required:
  - compatible
  - clocks
  - '#clock-cells'

additionalProperties: false

examples:
  - |
    bus {
      #address-cells = <1>;
      #size-cells = <1>;

      aes1_ick: aes1-ick@48004a14 {
        #clock-cells = <0>;
        compatible = "ti,omap3-interface-clock";
        clocks = <&security_l4_ick2>;
        reg = <0x48004a14 0x4>;
        ti,bit-shift = <3>;
      };

      cam_ick: cam-ick@48004f10 {
        #clock-cells = <0>;
        compatible = "ti,omap3-no-wait-interface-clock";
        clocks = <&l4_ick>;
        reg = <0x48004f10 0x4>;
        ti,bit-shift = <0>;
      };

      ssi_ick_3430es2: ssi-ick-3430es2@48004a10 {
        #clock-cells = <0>;
        compatible = "ti,omap3-ssi-interface-clock";
        clocks = <&ssi_l4_ick>;
        reg = <0x48004a10 0x4>;
        ti,bit-shift = <0>;
      };
    };
```

## Documentation/devicetree/bindings/power/supply/ti,twl6030-charger.yaml
```yaml
# SPDX-License-Identifier: GPL-2.0
%YAML 1.2
---
$id: http://devicetree.org/schemas/power/supply/ti,twl6030-charger.yaml#
$schema: http://devicetree.org/meta-schemas/core.yaml#

title: TWL6030/32 BCI (Battery Charger Interface)

description: |
  The battery charger needs to be configured to do any charging besides of
  precharging. The GPADC in the PMIC has to be used to get the related
  voltages.

maintainers:
  - Andreas Kemnade <andreas@kemnade.info>

allOf:
  - $ref: power-supply.yaml#

properties:
  compatible:
    oneOf:
      - items:
          - const: "ti,twl6030-charger"
      - items:
          - const: "ti,twl6032-charger"
          - const: "ti,twl6030-charger"

  interrupts:
    minItems: 2
    maxItems: 2

  io-channels:
    items:
      - description: VBUS Voltage Channel

  io-channel-names:
    items:
      - const: vusb

  monitored-battery:
    description:
      phandle of battery characteristics devicetree node

required:
  - compatible
  - interrupts
  - monitored-battery

additionalProperties: false

examples:
  - |
    pmic {
      bci {
        compatible = "ti,twl6032-charger", "ti,twl6030-charger";
        interrupts = <2>, <5>;
        io-channels = <&gpadc 10>;
        io-channel-names = "vusb";
        monitored-battery = <&bat>;
      };
    };
```

## drivers/input/elan/Kconfig
```kconfig
#
# ELAN configuration
#
#menuconfig INPUT_ELAN
#	bool "Elan Input Devices"
#	help
#	  Say Y here, and a list of supported ELAN input devices will be displayed.
#	  This option doesn't affect the kernel.

#	  If unsure, say Y.

#if INPUT_ELAN

config TOUCHPAD_ELAN_SPI_EKT1059
	tristate "Elan SPI ekt1059 touch pad devices"
	depends on SPI && INPUT
	default y

#endif
```

## drivers/video/fbdev/mxc/Kconfig
```kconfig
config FB_MXC
	tristate "MXC Framebuffer support"
	depends on FB
	select FB_CFB_FILLRECT
	select FB_CFB_COPYAREA
	select FB_CFB_IMAGEBLIT
	select FB_MODE_HELPERS
	default y
	help
	  This is a framebuffer device for the MXC LCD Controller.
	  See <http://www.linux-fbdev.org/> for information on framebuffer
	  devices.

	  If you plan to use the LCD display with your MXC system, say
	  Y here.

config FB_MXC_EINK_V2_PANEL
	depends on FB_MXC
	depends on DMA_ENGINE
	select FB_DEFERRED_IO
	tristate "E-Ink Panel Framebuffer based on EPDC V2"

config FB_MXC_EINK_AUTO_UPDATE_MODE
	bool "E-Ink Auto-update Mode Support"
	depends on FB_MXC_EINK_V2_PANEL
```
